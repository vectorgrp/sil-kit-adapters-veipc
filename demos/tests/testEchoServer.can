/*@!Encoding:65001*/
includes
{
  
}

variables
{  
  int result = 0;
  dword timeout = 2000;
  byte payloadArray[7] = {1, 12, 55, 41, 89, 23, 67};
  int payloadArraySize = 7;
  int i;
}

export testfunction PrepareTestscenario()
{
  Namespace::Adapter.Connect();
  resetDistObjValues(Namespace::Adapter);
  
  $Namespace::Adapter.toSocket.Length = payloadArraySize;
  
  for (i=0; i<payloadArraySize; i++)
  {
    $Namespace::Adapter.toSocket[i] = payloadArray[i];
  }
}

export testcase DO_EchoValueMatch()
{
  for (i=0; i<payloadArraySize; i++)
  {
    result = testWaitForImplValueUInt(Namespace::Adapter.fromSocket[i], payloadArray[i], timeout);
    if (result != 1)
    {
        TestStepFail("DO_EchoValueMatch", "FAILED: No value within timeout");
    }
  }
  TestStepPass("DO_EchoValueMatch", "SUCCESS");
}
